## main/Kconfig.projbuild
```kconfig
menu "Main Configuration"

    orsource "$IDF_PATH/examples/common_components/env_caps/$IDF_TARGET/Kconfig.env_caps"

    config I2C_MASTER_SCL
        int "SCL GPIO Num"
        range ENV_GPIO_RANGE_MIN ENV_GPIO_OUT_RANGE_MAX
        default 19 if IDF_TARGET_ESP32 || IDF_TARGET_ESP32S2 || IDF_TARGET_ESP32S3
        default 2
        help
            GPIO number for I2C Master clock line.

    config I2C_MASTER_SDA
        int "SDA GPIO Num"
        range ENV_GPIO_RANGE_MIN ENV_GPIO_OUT_RANGE_MAX
        default 18 if IDF_TARGET_ESP32 || IDF_TARGET_ESP32S2 || IDF_TARGET_ESP32S3
        default 1
        help
            GPIO number for I2C Master data line.

    config BROKER_URL
        string "MQTT Broker URL"
        default "mqtt://mqtt.eclipseprojects.io"
        help
            URL of the broker to connect to

    config NTP_URI
        string "Address of SNTP server"
        default "pool.ntp.org"
        help
            URL Address of SNTP server.

    config TIMEZONE_LOCATION
        string "Name of Sensor Location (General)"
        default "Adelaide"
        help
            The city or location where the sensor is generally.

    config TIMEZONE_LOCAL_STRING
        string "Timezone Location String"
        default "ACST-9:30ACDT,M10.1.0,M4.1.0/3"
        help
            The SNTP timezone where the sensor is located. Sensor data is reported using this timezone. See https://github.com/nayarsystems/posix_tz_db/blob/master/zones.csv

    config MEASUREMENT_PERIOD
        int "Time between publishing MQTT measurements, measured in ms"
        default 10000
        help
            The SNTP timezone where the sensor is located. Sensor data is reported using this timezone. See https://github.com/nayarsystems/posix_tz_db/blob/master/zones.csv

endmenu
```
